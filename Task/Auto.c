//
// Created by 14717 on 2025/9/2.
//

#include "Auto.h"
#include "cmsis_os.h"

/**********************************************************************************************************************/
/*应用INCLUDE*/
#include "../Application/mahony.h"

/**********************************************************************************************************************/
/*驱动INCLUDE*/
#include "../Driver/ins/ist8310_i2c/ist8310_i2c.h"
#include "../Driver/ins/BMI088/BMI088driver.h"
#include "../Driver/uart/dvc_uart.h"

/**********************************************************************************************************************/
/*数据*/
fp32 mag[3];//磁场强度
fp32 gyro[3];//角速度
fp32 accel[3];//加速度
fp32 temp;
fp32 INS_quat[4] = {1.0f, 0.0f, 0.0f, 0.0f};//四元数
fp32 INS_angle[3] = {0.0f, 0.0f, 0.0f};//姿态角（YAW ROW PITCH）
/**********************************************************************************************************************/
/*调试用的串口*/
struct uart_device *Uart2;

/*--------------------------------------------------------------------------------------------------------------------*/
/*--------------------------------------------------------------------------------------------------------------------*/

void Auto_task(void const * argument) {
    /******************************************************************************************************************/
    /*磁力计初始化（受干扰严重，姿态解算其实没有用磁力计）*/
    while(ist8310_init()){}

    /******************************************************************************************************************/
    /*陀螺仪初始化*/
    while (BMI088_init()) {}

    /******************************************************************************************************************/
    /*串口初始化*/
    Uart2 = uart_get_device("uart1_dma");
    Uart2->Init(Uart2, 115200, 8, 'N', 1);

    while (1) {
        /***************************************************************************************************************/
        /*磁力计数据更新*/
        ist8310_read_mag(mag);
        //Uart2->Print(Uart2,"%d,%d,%d\n",(int)(mag[0]),(int)(mag[1]),(int)(mag[2]));

        /***************************************************************************************************************/
        /*陀螺仪数据更新*/
        BMI088_read(gyro, accel, &temp);
        //Uart2->Print(Uart2, "%d,%d,%d\n", (int)(100*accel[0]), (int)(100*accel[1]), (int)(100*accel[2]));

        /***************************************************************************************************************/
        /*姿态解算更新四元数*/
        pos_update(INS_quat, gyro, accel, mag);
        get_angle(INS_quat, INS_angle);
        //Uart2->Print(Uart2,"%d,%d,%d\n",(int)(57.3*INS_angle[0]),(int)(-57.3*INS_angle[1]),(int)(-57.3*INS_angle[2]));

        vTaskDelay(1);
    }
}